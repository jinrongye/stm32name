/**
  ******************************************************************************
  * @file    user/oled.c
  * @author
  * @version V1.0
  * @date    2026-06-12
  * @brief   SSD1306 OLED driver (I2C via software/I2C1)
  ******************************************************************************
  */

/* Includes ------------------------------------------------------------------*/
#include "oled.h"
#include "stm32f10x_gpio.h"
#include "stm32f10x_rcc.h"
#include <stdarg.h>
#include <string.h>

/* Private define ------------------------------------------------------------*/
/* I2C1 GPIO pins: PB6 = SCL, PB7 = SDA */
#define OLED_I2C_PORT       GPIOB
#define OLED_I2C_SCL_PIN    GPIO_Pin_6
#define OLED_I2C_SDA_PIN    GPIO_Pin_7
#define OLED_I2C_RCC        RCC_APB2Periph_GPIOB

/* I2C timing macros */
#define OLED_SCL_H()        GPIO_SetBits(OLED_I2C_PORT, OLED_I2C_SCL_PIN)
#define OLED_SCL_L()        GPIO_ResetBits(OLED_I2C_PORT, OLED_I2C_SCL_PIN)
#define OLED_SDA_H()        GPIO_SetBits(OLED_I2C_PORT, OLED_I2C_SDA_PIN)
#define OLED_SDA_L()        GPIO_ResetBits(OLED_I2C_PORT, OLED_I2C_SDA_PIN)
#define OLED_SDA_READ()     GPIO_ReadInputDataBit(OLED_I2C_PORT, OLED_I2C_SDA_PIN)

/* Private variables ---------------------------------------------------------*/
/* OLED full-frame framebuffer: 128 x 64 / 8 = 1024 bytes */
static uint8_t OLED_GRAM[OLED_WIDTH][OLED_HEIGHT / 8];

/* Font lookups are defined in this file — ASCII 5x7 and 8x16 */

/* Exported functions --------------------------------------------------------*/

/**
  * @brief  软件 I2C 延时（72MHz 下约 10μs）
  * @note   部分 SSD1306 模块 I2C 时序较慢，延时需适当加大
  *         如果 OLED 仍不亮，尝试继续增大 i 的值
  */
static void I2C_Delay(void)
{
    volatile uint32_t i = 72;   /* 72MHz 下约 10μs，保障兼容性 */
    while (i--) { __NOP(); }
}

/**
  * @brief  Generate I2C start condition
  */
static void I2C_Start(void)
{
    OLED_SDA_H();
    OLED_SCL_H();
    I2C_Delay();
    OLED_SDA_L();
    I2C_Delay();
    OLED_SCL_L();
    I2C_Delay();
}

/**
  * @brief  Generate I2C stop condition
  */
static void I2C_Stop(void)
{
    OLED_SDA_L();
    OLED_SCL_L();
    I2C_Delay();
    OLED_SCL_H();
    I2C_Delay();
    OLED_SDA_H();
    I2C_Delay();
}

/**
  * @brief  Wait for I2C acknowledgement from slave
  * @retval 0 = ACK received, 1 = NAK
  */
static uint8_t I2C_WaitAck(void)
{
    uint8_t ack;
    OLED_SDA_H();               /* Release SDA for slave to pull low */
    I2C_Delay();
    OLED_SCL_H();
    I2C_Delay();
    ack = OLED_SDA_READ();      /* Read ACK bit */
    OLED_SCL_L();
    I2C_Delay();
    return ack;
}

/**
  * @brief  Send I2C ACK (master acknowledges slave)
  */
static void I2C_SendAck(void)
{
    OLED_SDA_L();
    I2C_Delay();
    OLED_SCL_H();
    I2C_Delay();
    OLED_SCL_L();
    I2C_Delay();
    OLED_SDA_H();
}

/**
  * @brief  Send I2C NAK (master does not acknowledge)
  */
static void I2C_SendNAck(void)
{
    OLED_SDA_H();
    I2C_Delay();
    OLED_SCL_H();
    I2C_Delay();
    OLED_SCL_L();
    I2C_Delay();
    OLED_SDA_L();
}

/**
  * @brief  Send one byte via I2C (MSB first)
  */
static void I2C_WriteByte(uint8_t data)
{
    uint8_t i;
    for (i = 0; i < 8; i++)
    {
        if (data & 0x80)
            OLED_SDA_H();
        else
            OLED_SDA_L();
        data <<= 1;
        I2C_Delay();
        OLED_SCL_H();
        I2C_Delay();
        OLED_SCL_L();
        I2C_Delay();
    }
    I2C_WaitAck();
}

/**
  * @brief  Write command byte to SSD1306
  */
void OLED_WriteCmd(uint8_t cmd)
{
    I2C_Start();
    I2C_WriteByte(OLED_I2C_ADDR);   /* Slave address + write */
    I2C_WriteByte(OLED_CMD_BYTE);   /* Control byte: command */
    I2C_WriteByte(cmd);             /* Command byte */
    I2C_Stop();
}

/**
  * @brief  Write data byte to SSD1306
  */
void OLED_WriteData(uint8_t data)
{
    I2C_Start();
    I2C_WriteByte(OLED_I2C_ADDR);   /* Slave address + write */
    I2C_WriteByte(OLED_DATA_BYTE);  /* Control byte: data */
    I2C_WriteByte(data);            /* Data byte */
    I2C_Stop();
}

/**
  * @brief  Set OLED cursor position (page: 0..7, column: 0..127)
  */
void OLED_SetPos(uint8_t page, uint8_t col)
{
    OLED_WriteCmd(0xB0 + page);             /* Set page address */
    OLED_WriteCmd(0x00 + (col & 0x0F));     /* Set lower column address */
    OLED_WriteCmd(0x10 + ((col >> 4) & 0x0F)); /* Set higher column address */
}

/**
  * @brief  Initialize SSD1306 OLED module
  */
void OLED_Init(void)
{
    GPIO_InitTypeDef GPIO_InitStructure;

    /* 使能 GPIOB 时钟 */
    RCC_APB2PeriphClockCmd(OLED_I2C_RCC, ENABLE);

    /* 配置 PB6 (SCL), PB7 (SDA) 为开漏输出，开启内部弱上拉 */
    GPIO_InitStructure.GPIO_Pin  = OLED_I2C_SCL_PIN | OLED_I2C_SDA_PIN;
    GPIO_InitStructure.GPIO_Mode = GPIO_Mode_Out_OD;
    GPIO_InitStructure.GPIO_Speed = GPIO_Speed_50MHz;
    GPIO_Init(OLED_I2C_PORT, &GPIO_InitStructure);

    /* 释放总线 */
    OLED_SCL_H();
    OLED_SDA_H();

    /* 上电等待（确保 SSD1306 内部电路稳定） */
    {
        volatile uint32_t d = 720000;
        while (d--) { __NOP(); }   /* 约 10ms */
    }

    /* SSD1306 初始化序列 */
    OLED_WriteCmd(0xAE); /* Display off */

    OLED_WriteCmd(0xD5); /* Set display clock divide ratio / oscillator frequency */
    OLED_WriteCmd(0x80); /* Default: 0x80 */

    OLED_WriteCmd(0xA8); /* Set multiplex ratio */
    OLED_WriteCmd(0x3F); /* 64 (0x3F) */

    OLED_WriteCmd(0xD3); /* Set display offset */
    OLED_WriteCmd(0x00); /* No offset */

    OLED_WriteCmd(0x40); /* Set start line = 0 */

    OLED_WriteCmd(0x8D); /* Charge pump setting */
    OLED_WriteCmd(0x14); /* Enable charge pump */

    OLED_WriteCmd(0x20); /* Set memory addressing mode */
    OLED_WriteCmd(0x02); /* Page addressing mode */

    OLED_WriteCmd(0xA1); /* Segment remap: column 127 mapped to SEG0 */
    OLED_WriteCmd(0xC8); /* COM output scan direction: remapped mode */

    OLED_WriteCmd(0xDA); /* Set COM pins hardware configuration */
    OLED_WriteCmd(0x12); /* Alternative COM pin configuration */

    OLED_WriteCmd(0x81); /* Set contrast control */
    OLED_WriteCmd(0xCF); /* Contrast value */

    OLED_WriteCmd(0xD9); /* Set pre-charge period */
    OLED_WriteCmd(0xF1);

    OLED_WriteCmd(0xDB); /* Set VCOMH deselect level */
    OLED_WriteCmd(0x40);

    OLED_WriteCmd(0xA4); /* Entire display ON (disable) — resume to RAM content */
    OLED_WriteCmd(0xA6); /* Normal display (not inverted) */

    OLED_WriteCmd(0x2E); /* Deactivate scrolling */

    OLED_Clear();
    OLED_Refresh();

    OLED_WriteCmd(0xAF); /* Display on */
}

/**
  * @brief  Turn the OLED display on
  */
void OLED_DisplayOn(void)
{
    OLED_WriteCmd(0x8D); /* Charge pump setting */
    OLED_WriteCmd(0x14); /* Enable charge pump */
    OLED_WriteCmd(0xAF); /* Display on */
}

/**
  * @brief  Turn the OLED display off
  */
void OLED_DisplayOff(void)
{
    OLED_WriteCmd(0x8D); /* Charge pump setting */
    OLED_WriteCmd(0x10); /* Disable charge pump */
    OLED_WriteCmd(0xAE); /* Display off */
}

/**
  * @brief  Clear the frame buffer (set all pixels to 0)
  */
void OLED_Clear(void)
{
    memset(OLED_GRAM, 0x00, sizeof(OLED_GRAM));
}

/**
  * @brief  Push full frame buffer to SSD1306 display
  */
void OLED_Refresh(void)
{
    uint8_t page, col;
    for (page = 0; page < OLED_HEIGHT / 8; page++)
    {
        OLED_SetPos(page, 0);
        I2C_Start();
        I2C_WriteByte(OLED_I2C_ADDR);
        I2C_WriteByte(OLED_DATA_BYTE);
        for (col = 0; col < OLED_WIDTH; col++)
        {
            I2C_WriteByte(OLED_GRAM[col][page]);
        }
        I2C_Stop();
    }
}

/**
  * @brief  Set / clear one pixel in the frame buffer
  * @param  x: column (0..127)
  * @param  y: row (0..63)
  * @param  dot: 1 = set, 0 = clear
  */
void OLED_DrawPoint(uint8_t x, uint8_t y, uint8_t dot)
{
    if (x >= OLED_WIDTH || y >= OLED_HEIGHT) return;
    if (dot)
        OLED_GRAM[x][y / 8] |=  (1 << (7 - (y % 8)));  /* MSB = top pixel */
    else
        OLED_GRAM[x][y / 8] &= ~(1 << (7 - (y % 8)));
}

/* ---- 5x7 font table (ASCII 0x20 ' ' through 0x7E '~') --------------------*/
static const uint8_t Font5x7[][5] = {
    {0x00,0x00,0x00,0x00,0x00}, /*   */  /* 0x20 */
    {0x00,0x00,0x5F,0x00,0x00}, /* ! */
    {0x00,0x07,0x00,0x07,0x00}, /* " */
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    {0x08,0x08,0x2A,0x1C,0x08}, /* ~ */
};

/* ---- 8x16 font table (ASCII 0x20 ' ' through 0x7E '~') -------------------*/
static const uint8_t Font8x16[][16] = {
    {0x00,0x00,0x00,0x00,0x00,0x00,0x00,0x00,0x00,0x00,0x00,0x00,0x00,0x00,0x00,0x00}, /*   */ /* 0x20 */
    {0x00,0x00,0x00,0xF8,0x00,0x00,0x00,0x00,0x00,0x00,0x00,0x33,0x30,0x00,0x00,0x00}, /* ! */
    {0x00,0x10,0x0C,0x06,0x10,0x0C,0x06,0x00,0x00,0x00,0x00,0x00,0x00,0x00,0x00,0x00}, /* " */
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    {0x00,0x06,0x01,0x01,0x02,0x02,0x04,0x04,0x00,0x00,0x00,0x00,0x00,0x00,0x00,0x00}, /* ~ */
};

/**
  * @brief  Display a character at the specified position
  * @param  x: column (0..127)
  * @param  y: row (0..63)
  * @param  chr: ASCII character to display
  * @param  size: font size (12 for 6x8, 16 for 8x16)
  */
void OLED_ShowChar(uint8_t x, uint8_t y, uint8_t chr, uint8_t size)
{
    uint8_t c, i;

    if (chr < ' ' || chr > '~') chr = ' ';

    if (size == 16)
    {
        /* 8x16 font: width=8, height=16 */
        if (x > OLED_WIDTH - 8) return;
        if (y > OLED_HEIGHT - 16) return;

        for (i = 0; i < 8; i++)
        {
            c = Font8x16[chr - 0x20][i];
            if (c & 0x80) OLED_DrawPoint(x + i, y + 0, 1);
            if (c & 0x40) OLED_DrawPoint(x + i, y + 1, 1);
            if (c & 0x20) OLED_DrawPoint(x + i, y + 2, 1);
            if (c & 0x10) OLED_DrawPoint(x + i, y + 3, 1);
            if (c & 0x08) OLED_DrawPoint(x + i, y + 4, 1);
            if (c & 0x04) OLED_DrawPoint(x + i, y + 5, 1);
            if (c & 0x02) OLED_DrawPoint(x + i, y + 6, 1);
            if (c & 0x01) OLED_DrawPoint(x + i, y + 7, 1);

            c = Font8x16[chr - 0x20][i + 8];
            if (c & 0x80) OLED_DrawPoint(x + i, y + 8, 1);
            if (c & 0x40) OLED_DrawPoint(x + i, y + 9, 1);
            if (c & 0x20) OLED_DrawPoint(x + i, y + 10, 1);
            if (c & 0x10) OLED_DrawPoint(x + i, y + 11, 1);
            if (c & 0x08) OLED_DrawPoint(x + i, y + 12, 1);
            if (c & 0x04) OLED_DrawPoint(x + i, y + 13, 1);
            if (c & 0x02) OLED_DrawPoint(x + i, y + 14, 1);
            if (c & 0x01) OLED_DrawPoint(x + i, y + 15, 1);
        }
    }
    else /* size == 12 (default 5x7 in 6x8 cell) */
    {
        if (x > OLED_WIDTH - 6) return;
        if (y > OLED_HEIGHT - 8) return;

        for (i = 0; i < 5; i++)
        {
            c = Font5x7[chr - 0x20][i];
            if (c & 0x80) OLED_DrawPoint(x + i, y + 0, 1);
            if (c & 0x40) OLED_DrawPoint(x + i, y + 1, 1);
            if (c & 0x20) OLED_DrawPoint(x + i, y + 2, 1);
            if (c & 0x10) OLED_DrawPoint(x + i, y + 3, 1);
            if (c & 0x08) OLED_DrawPoint(x + i, y + 4, 1);
            if (c & 0x04) OLED_DrawPoint(x + i, y + 5, 1);
            if (c & 0x02) OLED_DrawPoint(x + i, y + 6, 1);
            if (c & 0x01) OLED_DrawPoint(x + i, y + 7, 1);
        }
    }
}

/**
  * @brief  Display a string at the specified position
  * @param  x: start column (0..127)
  * @param  y: start row (0..63)
  * @param  str: null-terminated ASCII string
  * @param  size: font size (12 or 16)
  */
void OLED_ShowString(uint8_t x, uint8_t y, const char *str, uint8_t size)
{
    uint8_t char_width = (size == 16) ? 8 : 6;

    while (*str)
    {
        if (x > OLED_WIDTH - char_width)
        {
            x = 0;
            y += (size == 16) ? 16 : 8;
        }
        OLED_ShowChar(x, y, (uint8_t)*str, size);
        x += char_width;
        str++;
    }
}

/**
  * @brief  Internal power function: 10^n
  */
static uint32_t OLED_Pow(uint32_t base, uint8_t exp)
{
    uint32_t result = 1;
    while (exp--) result *= base;
    return result;
}

/**
  * @brief  Display an unsigned integer number
  * @param  x: start column
  * @param  y: start row
  * @param  num: number to display
  * @param  len: minimum number of digits
  * @param  size: font size (12 or 16)
  */
void OLED_ShowNum(uint8_t x, uint8_t y, uint32_t num, uint8_t len, uint8_t size)
{
    uint8_t i, digit;
    uint8_t char_width = (size == 16) ? 8 : 6;
    uint8_t enshow = 0;

    for (i = 0; i < len; i++)
    {
        digit = (num / (uint32_t)OLED_Pow(10, len - 1 - i)) % 10;
        if (digit != 0 || i == len - 1)
            enshow = 1;
        if (enshow)
            OLED_ShowChar(x + char_width * i, y, '0' + digit, size);
    }
}

/**
  * @brief  Display a signed integer number
  * @param  x: start column
  * @param  y: start row
  * @param  num: signed number to display
  * @param  len: minimum number of digits
  * @param  size: font size (12 or 16)
  */
void OLED_ShowSignedNum(uint8_t x, uint8_t y, int32_t num, uint8_t len, uint8_t size)
{
    uint8_t char_width = (size == 16) ? 8 : 6;

    if (num < 0)
    {
        OLED_ShowChar(x, y, '-', size);
        num = -num;
        x += char_width;
        len--;
    }
    OLED_ShowNum(x, y, (uint32_t)num, len, size);
}

/**
  * @brief  Formatted print to OLED (limited, for key-value display)
  * @note   Supports %d, %u, %s format specifiers
  */
void OLED_Printf(uint8_t x, uint8_t y, uint8_t size, const char *fmt, ...)
{
    va_list args;
    char buf[32];
    uint8_t i = 0;

    va_start(args, fmt);

    while (*fmt && i < 31)
    {
        if (*fmt == '%')
        {
            fmt++;
            if (*fmt == 'd')
            {
                int32_t val = va_arg(args, int32_t);
                char tmp[12];
                int8_t pos = 0;
                if (val < 0) { buf[i++] = '-'; val = -val; }
                if (val == 0) { tmp[pos++] = '0'; }
                else { while (val) { tmp[pos++] = '0' + (val % 10); val /= 10; } }
                while (pos) buf[i++] = tmp[--pos];
            }
            else if (*fmt == 'u')
            {
                uint32_t val = va_arg(args, uint32_t);
                char tmp[12];
                int8_t pos = 0;
                if (val == 0) { tmp[pos++] = '0'; }
                else { while (val) { tmp[pos++] = '0' + (val % 10); val /= 10; } }
                while (pos) buf[i++] = tmp[--pos];
            }
            else if (*fmt == 's')
            {
                const char *s = va_arg(args, const char *);
                while (*s && i < 31) buf[i++] = *s++;
            }
            else if (*fmt == 'c')
            {
                buf[i++] = (char)va_arg(args, int);
            }
        }
        else
        {
            buf[i++] = *fmt;
        }
        fmt++;
    }

    va_end(args);
    buf[i] = '\0';

    OLED_ShowString(x, y, buf, size);
}
